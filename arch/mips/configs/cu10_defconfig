## arch/mips/jz4740/Kconfig
```kconfig
choice
	prompt "Machine type"
	depends on MACH_INGENIC
	default JZ4740_QI_LB60

config JZ4740_QI_LB60
	bool "Qi Hardware Ben NanoNote"
	select MACH_JZ4740

config JZ4780_CI20
	bool "MIPS Creator CI20"
	select MACH_JZ4780

config X1000_CU_NEO
	bool "YSH & ATIL General Module CU Neo"
	select MACH_X1000

endchoice

config MACH_JZ4740
	bool
	select SYS_HAS_CPU_MIPS32_R1

config MACH_JZ4780
	bool
	select MIPS_CPU_SCACHE
	select SYS_HAS_CPU_MIPS32_R2
	select SYS_SUPPORTS_HIGHMEM

config MACH_X1000
	bool
	select PINCTRL
	select PINCTRL_INGENIC
	select CLKSRC_INGENIC_SYS_OST
	select MIPS_CPU_SCACHE
	select SYS_HAS_CPU_MIPS32_R2
	select SYS_SUPPORTS_HIGHMEM

config EXTAL_CLOCK
	depends on MACH_INGENIC
	int "extal clock in MHz"
	default 24
```

## arch/mips/xburst/Kconfig
```kconfig
menuconfig SOC_TYPE
	tristate "SOC type"
	depends on MACH_XBURST
	default y

if SOC_TYPE
choice
	prompt "SOC types"
	depends on MACH_XBURST
	default SOC_X1000

config SOC_X1000
	bool "x1000 socs"
	select INGENIC_INTC
	select CLK_X1000
	select CLKSRC_OF
	select PINCTRL
	select BUILTIN_DTB
	select CLKDEV_LOOKUP
	select PINCTRL_INGENIC
	select CLKSRC_INGENIC_SYS_OST
endchoice

choice
	prompt "device tree select"
	default DT_NONE
config DT_NONE

if SOC_X1000
source "arch/mips/xburst/soc-x1000/Kconfig.DT"
endif
endchoice

config EXTAL_CLOCK
	depends on MACH_XBURST
	int "extal clock in MHz"
	default 24

config INGENIC_GPT_CHECK
	depends on MACH_XBURST
	bool "The physical space is larger than the virtual space"
	default y

config SUSPEND_TEST
	bool "auto suspend test"
	default n

config SUSPEND_ALARM_TIME
	int "suspend alarm time(second)"
	depends on SUSPEND_TEST
	default 2

endif
```

## drivers/clk/ingenic/Kconfig
```kconfig
config COMMON_CLK_INGENIC
	bool
	depends on MACH_XBURST
	select MFD_SYSCON
	select COMMON_CLK

config CLK_X1000
	bool
	depends on SOC_X1000
	select COMMON_CLK_INGENIC
	help
	  build the ingenic x1000 soc clock driver.
```

## drivers/net/ethernet/ingenic/Kconfig
```kconfig
config INGENIC_MAC
	tristate "ingenic on-chip MAC support"
	select CRC32
	select RMII
	select MII
	help
	  This is the driver for INGENIC on-chip mac device.

config INGENIC_MAC_MODE
	tristate "ingenic on-chip MAC support mode"
	depends on INGENIC_MAC
	select CRC32
	select RMII
	select PHYLIB
	select PHY_RESET
	help
	  This is the driver for INGENIC on-chip mac support mode device.

choice
	prompt "INGENIC SOC MAC mode"
	depends on INGENIC_MAC_MODE
	default CONFIG_INGENIC_MAC_MII

config INGENIC_MAC_MII
	bool "MII"
	help
	  Select Media Independent Interface

config INGENIC_MAC_GMII
	bool "GMII"
	help
	  Select Gigabit Media Independent Interface

config INGENIC_MAC_RMII
	bool "RMII"
	help
	  Select Reduced Media Independent Interface

config INGENIC_MAC_RGMII
	bool "RGMII"
	help
	  Select Reduced Gigabit Media Independent Interface
endchoice

config INGENIC_GPIO_PHY_RESET
    bool "PHY_RESET"
	depends on INGENIC_MAC
	help
	  This is the gpio for phy reset for ingenic net
	  if there is no special porpose
	  do open this item
```

## drivers/video/fbdev/ingenic/Kconfig
```kconfig
menuconfig FB_INGENIC
	tristate "Ingenic Framebuffer Driver"
	depends on FB
	select FB_CFB_FILLRECT
	select FB_CFB_COPYAREA
	select FB_CFB_IMAGEBLIT
	help
		LCD Driver for X1000

config FB_INGENIC_NR_FRAMES
	int "how many frames support"
	depends on FB_INGENIC
	default 3

choice
	depends on FB_INGENIC
	prompt "Framebuffer format"
	default LCD_FB_FORMAT_16BIT
config LCD_FB_FORMAT_16BIT
	bool "Support 16bpp framebuffer"
config LCD_FB_FORMAT_24BIT
	bool "Support 24bpp framebuffer"
endchoice

config FB_INGENIC_DEBUG
        bool "fb test for displaying color bar"
        depends on FB_INGENIC
        default n
        help
           fb test for displaying color bar in your board.

config SLCDC_LOW_POWER_CONSUMPTION
        bool "Low power consumption mode (experimental)"
        depends on FB_INGENIC
        default n
        help
	In this mode, will startup the LCD clk and pixel clk only at user operate the frame buffer device.
	This will save 6mW at sigal frame mode, or 24mW at contiune frame mode.
	notice:
	    Because of the clk has been shutdown, the sys node will invalid like read register draw color bar ...

config SLCDC_CONTINUA
    tristate "SLCDC CONTINUA TRANFER"
    depends on FB_INGENIC
    default n

config SLCDC_USE_TE
	tristate "SLCDC USE TE SIGNAL"
	depends on FB_INGENIC
	default n

if FB_INGENIC
source "drivers/video/fbdev/ingenic/displays/Kconfig"
endif
```

## drivers/video/fbdev/ingenic/displays/Kconfig
```kconfig
menuconfig FB_INGENIC_DISPLAYS
	tristate "Supported lcd panels"
	depends on FB_INGENIC
	select BACKLIGHT_LCD_SUPPORT
	select LCD_CLASS_DEVICE
	select BACKLIGHT_CLASS_DEVICE


config PANEL_TRULY_TFT240240_2_E
	tristate "lcd panel truly tft240240"
	depends on FB_INGENIC_DISPLAYS
	help
		lcd panel truly tft240240, for ingenicfb drivers.
```

## sound/soc/ingenic/Kconfig
```kconfig
menuconfig SND_ASOC_INGENIC
	tristate "ASoC support for Ingenic"
	depends on MACH_XBURST && SND_SOC
	help
		Say 'Y' to enable Alsa drivers of xburst.

if SND_ASOC_INGENIC

config SND_ASOC_INGENIC_X1000_BOARD
	tristate

config SND_ASOC_INGENIC_AIC
	tristate

config SND_ASOC_PDMA
	tristate
	select DMADEVICES
	select INGENIC_PDMAC
	select SND_SOC_GENERIC_DMAENGINE_PCM

config SND_ASOC_INGENIC_AIC_SPDIF
	tristate
	select SND_ASOC_INGENIC_AIC

config SND_ASOC_INGENIC_AIC_I2S
	tristate
	select SND_ASOC_INGENIC_AIC

config SND_ASOC_INGENIC_DMIC
	tristate

config SND_ASOC_INGENIC_ICDC_D3
	tristate
	select SND_ASOC_INGENIC_AIC
	select SND_ASOC_INGENIC_INCODEC

config SND_ASOC_INGENIC_DUMP_CODEC
	tristate

menu "ingenic board type select"
choice
	prompt "soc x1000 codec type select"
	depends on SOC_X1000
config SND_ASOC_INGENIC_HALLEY2_ICDC
	tristate "Audio support for halley2 with internal codec"
	select SND_ASOC_PDMA
	select SND_ASOC_INGENIC_AIC_I2S
	select SND_ASOC_INGENIC_ICDC_D3
	select SND_ASOC_INGENIC_DMIC
	select SND_ASOC_INGENIC_DUMP_CODEC
	select SND_ASOC_INGENIC_X1000_BOARD

config SND_ASOC_INGENIC_HALLEY2_SPDIF
	tristate "Audio support for halley2 with spdif"
	select SND_ASOC_PDMA
	select SND_ASOC_INGENIC_DMIC
	select SND_ASOC_INGENIC_DUMP_CODEC
	select SND_ASOC_INGENIC_X1000_BOARD
	select SND_ASOC_INGENIC_AIC_SPDIF
endchoice

endmenu

endif
```
